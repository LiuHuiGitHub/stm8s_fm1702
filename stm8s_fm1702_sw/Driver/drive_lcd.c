#include "iostm8s105k6.h"
#include "drive_lcd.h"
#include "sys_delay.h"
//--------------------------------------------------------- 4线SPI接口 驱动

#define    CS0		PD_ODR_ODR2
#define    RSTB		PB_ODR_ODR0
#define    RS		PD_ODR_ODR3
#define    SCL		PD_ODR_ODR4
#define    SDI		PD_ODR_ODR7


static UINT8 PicBuff[128 * 8] = {0};


void drv_lcdWriteCmd(UINT8 cmd);
void drv_lcdWriteData(UINT8 data);

void drv_lcdReset(void)
{
    RSTB = 0;
    sys_delayms(2);
    RSTB = 1;
}

void drv_lcdInit(void)
{
    drv_lcdReset();
    sys_delayms(10);

    drv_lcdWriteCmd(0xe2);		//Soft rest

    drv_lcdWriteCmd(0xa2);		//SET LCD bias(A2-1/9bias; A3-1/7bias)
    drv_lcdWriteCmd(0xa0);		//SET ADC NORMAL(OB-POR seg0-00h) A0: NORMAL  A1: REVERSE
    drv_lcdWriteCmd(0xc8);		//SET COM OUTPUT SCAN DIRECTION(0XXXB-NORMAL)-POR  COM63-->COM0

    drv_lcdWriteCmd(0xa4);		// SET DISPLAY NORMAL (0B-NORMAL)-POR  A4:NORMAL A5:ENTIRE DISPLAY ON
    drv_lcdWriteCmd(0xa6);		//SET NORMAL DISPLAY MODE(0B-NORMAL)  A6:NORMAL  A7:REVERSE
    drv_lcdWriteCmd(0x25);		//SET INTERNAL REGULATOR RESDASTOR RATIO(100B)-POR

    drv_lcdWriteCmd(0x81);

    drv_lcdWriteCmd(0x0f);		// SET CONTRAST CONTROL REGISTER(00,0000H-11,1111H) 30  对比度请修改此值，调浓增大此值，反之调淡。
    drv_lcdWriteCmd(0x2f);		//SET POWER CONTROL REGISTER (ALL INTERNAL)

    drv_lcdWriteCmd(0x40);		//end of initialzation

    drv_lcdDrawPicture(PicBuff);
    
    drv_lcdWriteCmd(0xaf);		//DisPlay On
}

void drv_lcdWriteCmd(UINT8 cmd)
{
    UINT8 i;
    RS = 0;
    CS0 = 0;
    for(i = 0; i < 8; i++)
    {
        SCL = 0;
        if(cmd & 0x80)
        {
            SDI = 1;
        }
        else
        {
            SDI = 0;
        }
        SCL = 1;
        cmd = (cmd << 1);

    }
}

void drv_lcdWriteData(UINT8 data)
{
    UINT8 i;
    RS = 1;
    CS0 = 0;

    for(i = 0; i < 8; i++)
    {
        SCL = 0;
        if(data & 0x80)
        {
            SDI = 1;
        }
        else
        {
            SDI = 0;
        }
        SCL = 1;
        data = (data << 1);
    }
}

void drv_lcdDrawFillColor(UINT8 color)
{
    UINT16 i;
    UINT8 data;
    if(color)
    {
        data = 0xFF;
    }
    else
    {
        data = 0x00;
    }
    for(i = 0; i < 1024; i++)
    {
        PicBuff[i] = data;
    }
}

void Ldrv_lcdDisPlayPicBuff(void)
{
    drv_lcdDrawPicture(PicBuff);
}

void drv_lcdDrawPoint(UINT8 x, UINT8 y, UINT8 color)
{
    UINT8 pic_bit;
    UINT16 pic_byte;
    x &= 0x7F;
    y &= 0x3F;
    pic_bit = y & 0x07;
    pic_byte = ((y >> 3) << 7) | x;

    if(color == 0x01)
        PicBuff[pic_byte] |= 1 << pic_bit;
    else if(color == 0x00)
        PicBuff[pic_byte] &= ~(1 << pic_bit);
    else
        PicBuff[pic_byte] ^= 1 << pic_bit;
}

UINT8 drv_lcdReadPoint(UINT8 x, UINT8 y)
{
    UINT8 pic_bit;
    UINT16 pic_byte;
    x &= 0x7F;
    y &= 0x3F;
    pic_bit = y & 0x07;
    pic_byte = ((y >> 3) << 7) | x;

    if(PicBuff[pic_byte] & ( 1 << pic_bit))
    {
        return 1;
    }
    else
    {
        return 0;
    }
}

const UINT8 swapTable[256] = 
{
	0x00,0x80,0x40,0xC0,0x20,0xA0,0x60,0xE0,0x10,0x90,0x50,0xD0,0x30,0xB0,0x70,0xF0,
	0x08,0x88,0x48,0xC8,0x28,0xA8,0x68,0xE8,0x18,0x98,0x58,0xD8,0x38,0xB8,0x78,0xF8,
	0x04,0x84,0x44,0xC4,0x24,0xA4,0x64,0xE4,0x14,0x94,0x54,0xD4,0x34,0xB4,0x74,0xF4,
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	0x0F,0x8F,0x4F,0xCF,0x2F,0xAF,0x6F,0xEF,0x1F,0x9F,0x5F,0xDF,0x3F,0xBF,0x7F,0xFF
};

void drv_lcdDrawPicture(const UINT8 *ptr)
{
    UINT8 i, j;
    
    ptr += 1023;
    CS0 = 0;
    for(i = 0; i < 8; i++)
    {
        drv_lcdWriteCmd(0xb0 + i);
        drv_lcdWriteCmd(0x10);
        drv_lcdWriteCmd(0x00);
        for(j = 0; j < 128; j++)
        {
            drv_lcdWriteData(swapTable[*ptr--]);
        }
    }
}
